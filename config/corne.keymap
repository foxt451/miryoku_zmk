// Copyright 2021 Manna Harbour
// https://github.com/manna-harbour/miryoku

#include "../miryoku/custom_config.h"
#include "../miryoku/mapping/42/corne.h"
#include "../miryoku/miryoku.dtsi"
/ {
  combos {
    compatible = "zmk,combos";
    tmux_prefix {
      timeout-ms = <40>;
      key-positions = <16 28>;
      bindings = <&kp LC(A)>;
      layers = <U_BASE>;
    };
  };
};
